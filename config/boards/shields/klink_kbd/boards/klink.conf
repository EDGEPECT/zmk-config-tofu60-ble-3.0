## config/boards/shields/klink_kbd/boards/klink.conf
```kconfig
# All config for this keyboard
CONFIG_BUILD_OUTPUT_UF2_FAMILY_ID="0x59952840"

CONFIG_SPI=y

# USB
CONFIG_ZMK_USB=y
CONFIG_USB_DEVICE_VID=0x9D5B
CONFIG_USB_DEVICE_PID=0x2562
CONFIG_USB_DEVICE_MANUFACTURER="KBDFans"
CONFIG_ZMK_KEYBOARD_NAME="Tofu60 BLE 3.0(USB)"

# BLE
CONFIG_ZMK_BLE=y
CONFIG_BT_DEVICE_NAME_MAX=23
CONFIG_BT_DEVICE_NAME="Tofu60 BLE 3.0"
CONFIG_ZMK_BLE_EXPERIMENTAL_CONN=y
CONFIG_BT_CTLR_TX_PWR_PLUS_8=y

# Battery
CONFIG_BT_BAS=n

# Power Management (절전 및 전원 설정)
CONFIG_ZMK_IDLE_TIMEOUT=60000
CONFIG_ZMK_SLEEP=y
CONFIG_ZMK_IDLE_SLEEP_TIMEOUT=600000

# Soft Off (수동 전원 차단 활성화)
CONFIG_ZMK_PM_SOFT_OFF=y

# HID & Pointing
CONFIG_ZMK_HID_CONSUMER_REPORT_USAGES_FULL=y
CONFIG_ZMK_HID_GENERIC_DESKTOP_USAGES_BASIC=y
CONFIG_ZMK_POINTING=y
CONFIG_ZMK_HID_INDICATORS=y

CONFIG_ZMK_KSCAN_DEBOUNCE_PRESS_MS=3
CONFIG_ZMK_KSCAN_DEBOUNCE_RELEASE_MS=5

# ZMK Studio 설정
CONFIG_ZMK_STUDIO=y
CONFIG_ZMK_STUDIO_LOCKING=n
CONFIG_ZMK_STUDIO_LOCK_ON_DISCONNECT=n
```
